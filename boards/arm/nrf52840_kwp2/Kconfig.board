## boards/arm/nrf52840_kwp2/Kconfig.board
```kconfig
# nRF52840 DK NRF52840 board configuration

# Copyright (c) 2016 Nordic Semiconductor ASA
# SPDX-License-Identifier: Apache-2.0

config BOARD_NRF52840_KWP2
	bool "nRF52840 DK NRF52840"
	depends on SOC_NRF52840_QIAA
```

## boards/arm/nrf52840_kwp2/Kconfig.defconfig
```kconfig
# nRF52840 DK NRF52840 board configuration

# Copyright (c) 2016 Nordic Semiconductor ASA
# SPDX-License-Identifier: Apache-2.0

if BOARD_NRF52840_KWP2

config BOARD
	default "nrf52840_kwp2"

if USB

config USB_NRFX
	default y

config USB_DEVICE_STACK
	default y

endif # USB

config IEEE802154_NRF5
	default y
	depends on IEEE802154

config BT_CTLR
	default BT

endif # BOARD_NRF52840_KWP2
```

## tests/test_app_loader/testcase.yaml
```yaml
tests:
    test.simple_module:
        extra_args: CONF_FILE="../../prj.conf"
        extra_configs:
            - CONFIG_ZTEST=y
        platform_whitelist: native_posix
        tags: simple_module
```
